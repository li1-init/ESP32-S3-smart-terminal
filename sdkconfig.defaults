## sdkconfig.defaults
```kconfig
# ===================== Flash =====================
CONFIG_ESPTOOLPY_FLASHSIZE_16MB=y
CONFIG_ESPTOOLPY_FLASHSIZE="16MB"
CONFIG_ESPTOOLPY_FLASHMODE_DIO=y
CONFIG_ESPTOOLPY_FLASHMODE="dio"

# ===================== PSRAM（板载八线 PSRAM）=====================
CONFIG_SPIRAM=y
CONFIG_SPIRAM_MODE_OCT=y

# ===================== CPU / 系统 =====================
CONFIG_ESP_DEFAULT_CPU_FREQ_MHZ_240=y
CONFIG_ESP_DEFAULT_CPU_FREQ_MHZ=240
CONFIG_FREERTOS_HZ=100

# ===================== LVGL =====================
CONFIG_LV_CONF_SKIP=y
CONFIG_LV_COLOR_DEPTH_16=y
CONFIG_LV_COLOR_DEPTH=16
CONFIG_LV_DEF_REFR_PERIOD=20
CONFIG_LV_DPI_DEF=130
CONFIG_LV_OS_NONE=y
CONFIG_LV_USE_CLIB_MALLOC=y
CONFIG_LV_USE_CLIB_STRING=y
CONFIG_LV_USE_CLIB_SPRINTF=y

# ---- 下面三个是我们踩坑后必须开的（别关！）----
# 日历界面用到了 lv_calendar_t->btnm 等内部成员，不开这个编译不过
CONFIG_LV_USE_PRIVATE_API=y
# 从文件系统读图片（天气图标走 SPIFFS，路径形如 A:/image/14@1x.png）
CONFIG_LV_USE_FS_STDIO=y
CONFIG_LV_FS_STDIO_LETTER=65
CONFIG_LV_FS_STDIO_PATH=""
CONFIG_LV_FS_STDIO_CACHE_SIZE=0
# PNG 解码器：天气图标是 PNG，不开的话路径能取到、文件能打开，但解不出图 → 图标永远不显示
CONFIG_LV_USE_LODEPNG=y

# ===================== 任务栈 =====================
# LVGL 需要较大栈；main 任务默认 3584 太小
CONFIG_ESP_MAIN_TASK_STACK_SIZE=8192

# ===== 中文字体（LVGL 自带的思源黑体，含常用汉字）=====
CONFIG_LV_FONT_SOURCE_HAN_SANS_SC_16_CJK=y
CONFIG_LV_FONT_DEFAULT_SOURCE_HAN_SANS_SC_16_CJK=y

# WebSocket 配网页面需要
CONFIG_HTTPD_WS_SUPPORT=y


# 关闭 LVGL 示例和 Demo，减少编译量
# CONFIG_LV_BUILD_EXAMPLES is not set
# CONFIG_LV_BUILD_DEMOS is not set


# 自定义分区表：html SPIFFS + 更大的 factory
CONFIG_PARTITION_TABLE_CUSTOM=y
CONFIG_PARTITION_TABLE_CUSTOM_FILENAME="partitions.csv"
CONFIG_FREERTOS_USE_TRACE_FACILITY=y
CONFIG_FREERTOS_USE_STATS_FORMATTING_FUNCTIONS=y
CONFIG_FREERTOS_VTASKLIST_INCLUDE_COREID=y
CONFIG_FREERTOS_GENERATE_RUN_TIME_STATS=y
CONFIG_FREERTOS_RUN_TIME_STATS_USING_ESP_TIMER=y
CONFIG_LV_USE_KEYBOARD=y
CONFIG_LV_USE_TEXTAREA=y
CONFIG_LV_USE_BUTTONMATRIX=y
CONFIG_FREERTOS_TIMER_TASK_STACK_DEPTH=3584
```
